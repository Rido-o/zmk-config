## config/west.yml
```yaml
manifest:
  remotes:
    - name: zmkfirmware
      url-base: https://github.com/zmkfirmware
    - name: carrefinho
      url-base: https://github.com/carrefinho
  projects:
    - name: zmk
      remote: zmkfirmware
      revision: 4dd95d7840eb3d5a3f59bb29fbf1ab054715ef85 # main
      import: app/west.yml
    - name: prospector-zmk-module
      remote: carrefinho
      revision: ed98221f3b52b7066dbb10ba3af8a29150b93a5a # feat/new-status-screens
  self:
    path: config
```
